## Kconfig
```kconfig
# Audio Codec configuration options

# Copyright (c) 2018 Intel Corporation
# SPDX-License-Identifier: Apache-2.0

menu "T58XX Digital Microphone"
	menuconfig T58XX
		bool "Digital Microphone (Audio) Drivers"
		default y
		help
		Enable Digital Microphone Driver Configuration.

	if T58XX

	config T58XX_AAD_TRIGGER
		bool "Enable AAD functionality"
		default y
		help
		Enable AAD triggering functionality.

	endif # T58XX
endmenu
```
